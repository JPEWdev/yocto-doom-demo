## meta-doom/conf/layer.conf
```bitbake
# Copyright (C) 2020 Joshua Watt <JPEWhacker@gmail.com>
# Released under the MIT license (see COPYING.MIT for the terms)

# We have a conf and classes directory, add to BBPATH
BBPATH .= ":${LAYERDIR}"

# We have recipes-* directories, add to BBFILES
BBFILES += "${LAYERDIR}/recipes-*/*/*.bb ${LAYERDIR}/recipes-*/*/*.bbappend"

BBFILE_COLLECTIONS += "doom"
BBFILE_PATTERN_doom = "^${LAYERDIR}/"
BBFILE_PRIORITY_doom = "10"

# This should only be incremented on significant changes that will
# cause compatibility issues with other layers
LAYERVERSION_doom = "1"
LAYERSERIES_COMPAT_doom = "gatesgarth"
LAYERDEPENDS_doom = "core"
```

## meta-rockpix/conf/layer.conf
```bitbake
# Copyright (C) 2020 Joshua Watt <JPEWhacker@gmail.com>
# Released under the MIT license (see COPYING.MIT for the terms)

# We have a conf and classes directory, add to BBPATH
BBPATH .= ":${LAYERDIR}"

# We have recipes-* directories, add to BBFILES
BBFILES += "${LAYERDIR}/recipes-*/*/*.bb ${LAYERDIR}/recipes-*/*/*.bbappend"

BBFILE_COLLECTIONS += "rockpix"
BBFILE_PATTERN_rockpix = "^${LAYERDIR}/"
BBFILE_PRIORITY_rockpix = "10"

# This should only be incremented on significant changes that will
# cause compatibility issues with other layers
LAYERVERSION_rockpix = "1"
LAYERSERIES_COMPAT_rockpix = "gatesgarth hardknott"
LAYERDEPENDS_rockpix = "core"
```

## meta-rockpix/conf/machine/rock-pi-x.conf
```bitbake
#@TYPE: Machine
#@NAME: Generic x86_64
#@DESCRIPTION: Machine configuration for generic x86_64 (64-bit) PCs and servers. Supports a moderately wide range of drivers that should boot and be usable on "typical" hardware.

DEFAULTTUNE ?= "core2-64"
require conf/machine/include/tune-core2.inc
include conf/machine/include/x86-base.inc
require conf/machine/include/qemuboot-x86.inc

MACHINE_FEATURES += "wifi efi pcbios"

PREFERRED_PROVIDER_virtual/kernel ?= "linux-yocto"
KCONFIG_MODE ?= "alldefconfig"
KBUILD_DEFCONFIG ?= "x86_64_defconfig"

PREFERRED_PROVIDER_virtual/xserver ?= "xserver-xorg"
XSERVER ?= "${XSERVER_X86_BASE} \
            ${XSERVER_X86_EXT} \
            ${XSERVER_X86_I915} \
            ${XSERVER_X86_I965} \
            ${XSERVER_X86_FBDEV} \
            ${XSERVER_X86_VESA} \
            ${XSERVER_X86_MODESETTING} \
           "

GLIBC_ADDONS = "nptl"

IMAGE_FSTYPES += "wic wic.bmap"
WKS_FILE ?= "rock-pi-x.wks.in"
EFI_PROVIDER ??= "grub-efi"
do_image_wic[depends] += "gptfdisk-native:do_populate_sysroot"
do_image_wic[recrdeptask] += "do_bootimg"

SERIAL_CONSOLES = "115200;ttyS2 115200;ttyS0"

MACHINE_EXTRA_RRECOMMENDS += "kernel-modules linux-firmware"

#For runqemu
QB_SYSTEM_NAME = "qemu-system-x86_64"
```
